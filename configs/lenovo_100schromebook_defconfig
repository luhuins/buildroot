## configs/lenovo_100schromebook_defconfig
```kconfig
BR2_x86_64=y

# toolchain
BR2_TOOLCHAIN_BUILDROOT_MUSL=y
BR2_TOOLCHAIN_BUILDROOT_LOCALE=y
BR2_TOOLCHAIN_BUILDROOT_USE_SSP=y
BR2_GCC_ENABLE_LTO=y
BR2_PIC_PIE=y
BR2_SSP_ALL=y

# Kernel
BR2_PACKAGE_HOST_KMOD_XZ=y
BR2_LINUX_KERNEL_NEEDS_HOST_LIBELF=y
BR2_LINUX_KERNEL_NEEDS_HOST_OPENSSL=y
BR2_LINUX_KERNEL=y
BR2_LINUX_KERNEL_XZ=y
BR2_LINUX_KERNEL_USE_CUSTOM_CONFIG=y
BR2_LINUX_KERNEL_CUSTOM_CONFIG_FILE="board/lenovo-100schromebook-luhui/linux.config"
BR2_PACKAGE_KMOD_TOOLS=y
BR2_PACKAGE_XZ=y
BR2_PACKAGE_LINUX_FIRMWARE=y
BR2_PACKAGE_LINUX_FIRMWARE_INTEL_SST_DSP=y
BR2_PACKAGE_LINUX_FIRMWARE_I915=y
BR2_PACKAGE_LINUX_FIRMWARE_IWLWIFI_7260=y

# rootfs
BR2_TARGET_ROOTFS_CPIO=y
BR2_TARGET_ROOTFS_CPIO_XZ=y
BR2_TARGET_ROOTFS_INITRAMFS=y

# system
BR2_ROOTFS_MERGED_USR=y
BR2_TARGET_GENERIC_HOSTNAME="lenovo-100schromebook-luhui"
BR2_TARGET_GENERIC_ISSUE="Welcome to Linux"
BR2_ROOTFS_DEVICE_CREATION_DYNAMIC_EUDEV=y
BR2_TARGET_GENERIC_PASSWD_SHA512=y
BR2_SYSTEM_ENABLE_NLS=y
BR2_TARGET_TZ_INFO=y

# small size
BR2_OPTIMIZE_S=y

# busybox
BR2_PACKAGE_BUSYBOX_SHOW_OTHERS=y
BR2_PACKAGE_BUSYBOX_CONFIG_FRAGMENT_FILES="board/lenovo-100schromebook-luhui/addtion-busybox.config"

# TLS support
BR2_PACKAGE_CA_CERTIFICATES=y

# sound
BR2_PACKAGE_ALSA_UTILS=y
BR2_PACKAGE_ALSA_UTILS_ALSACTL=y
BR2_PACKAGE_ALSA_UTILS_ALSAMIXER=y
BR2_PACKAGE_ALSA_UTILS_ALSAUCM=y
BR2_PACKAGE_ALSA_UTILS_APLAY=y
BR2_PACKAGE_ALSA_LIB_OLD_SYMBOLS=y
BR2_PACKAGE_MPG123=y

# filesystem
BR2_PACKAGE_DOSFSTOOLS=y
BR2_PACKAGE_DOSFSTOOLS_FATLABEL=y
BR2_PACKAGE_DOSFSTOOLS_FSCK_FAT=y
BR2_PACKAGE_DOSFSTOOLS_MKFS_FAT=y
BR2_PACKAGE_BTRFS_PROGS=y
BR2_PACKAGE_E2FSPROGS=y
BR2_PACKAGE_E2FSPROGS_FSCK=y
BR2_PACKAGE_CRYPTSETUP=y

# chinese display
BR2_PACKAGE_NCURSES_WCHAR=y
BR2_PACKAGE_KMSCON=y
BR2_PACKAGE_LIBDRM_INTEL=y
# chinese input
BR2_PACKAGE_UIM=y
BR2_PACKAGE_UIM_FEP=y

# Picture viewer
BR2_PACKAGE_FBV=y
BR2_PACKAGE_FBV_PNG=y
BR2_PACKAGE_FBV_JPEG=y

# WLAN
BR2_PACKAGE_WIRELESS_REGDB=y
BR2_PACKAGE_WIRELESS_TOOLS=y
BR2_PACKAGE_WPA_SUPPLICANT=y
BR2_PACKAGE_WPA_SUPPLICANT_NL80211=y
BR2_PACKAGE_WPA_SUPPLICANT_WPA3=y
BR2_PACKAGE_WPA_SUPPLICANT_CLI=y
BR2_PACKAGE_WPA_SUPPLICANT_WPA_CLIENT_SO=y
BR2_PACKAGE_WPA_SUPPLICANT_PASSPHRASE=y
BR2_PACKAGE_WPA_SUPPLICANT_CTRL_IFACE=y

# VPN
BR2_PACKAGE_WIREGUARD_TOOLS=y

# Terminal
BR2_PACKAGE_TMUX=y
BR2_PACKAGE_SCREEN=y

# Security
BR2_PACKAGE_ACL=y
BR2_PACKAGE_INTEL_MICROCODE=y
BR2_PACKAGE_IUCODE_TOOL=y

# Compression
BR2_PACKAGE_ZSTD=y
BR2_PACKAGE_BZIP2=y
BR2_PACKAGE_GZIP=y


# Remote Access
BR2_PACKAGE_DROPBEAR=y
BR2_PACKAGE_DROPBEAR_CLIENT=y
BR2_PACKAGE_DROPBEAR_SMALL=y

# Mail client
BR2_PACKAGE_MSMTP=y
BR2_PACKAGE_MUTT=y
BR2_PACKAGE_MUTT_IMAP=y
BR2_PACKAGE_MUTT_POP3=y

# Encrypt
BR2_PACKAGE_PINENTRY_NCURSES=y
BR2_PACKAGE_PINENTRY=y
BR2_PACKAGE_GNUPG2=y
BR2_PACKAGE_GNUPG2_GPGV=y
BR2_PACKAGE_LIBOPENSSL_BIN=y

# Firewall
BR2_PACKAGE_NFTABLES=y

# Bootloader
BR2_TARGET_GRUB2=y
BR2_TARGET_GRUB2_X86_64_EFI=y
BR2_TARGET_GRUB2_BUILTIN_MODULES="boot linux fat part_msdos part_gpt normal efi_gop"

# User's custom configuration
BR2_ROOTFS_OVERLAY="board/lenovo-100schromebook-luhui/overlay/"

# For Recovery
BR2_PACKAGE_TAR=y
BR2_PACKAGE_QEMU=y
BR2_PACKAGE_QEMU_CUSTOM_TARGETS="x86_64-sofmmu"
BR2_PACKAGE_QEMU_TOOLS=y
```

## configs/raspberrypi0w_password_manager_defconfig
```kconfig
# CPU
BR2_arm=y
BR2_arm1176jzf_s=y
BR2_ARM_EABIHF=y

# TOOLCHAIN
BR2_PACKAGE_HOST_LINUX_HEADERS_CUSTOM_5_10=y
BR2_TOOLCHAIN_BUILDROOT_MUSL=y
BR2_GCC_ENABLE_LTO=y
BR2_PIC_PIE=y
BR2_SSP_ALL=y
BR2_RELRO_FULL=y

# SYSTEM
BR2_ROOTFS_DEVICE_CREATION_DYNAMIC_MDEV=y
BR2_TARGET_GENERIC_HOSTNAME="rpi0w"
BR2_TARGET_GENERIC_ISSUE="Welcome to RPI0W"
BR2_ROOTFS_MERGED_USR=y
BR2_SYSTEM_ENABLE_NLS=y
BR2_TARGET_TZ_INFO=y

# KERNEL
BR2_LINUX_KERNEL=y
BR2_LINUX_KERNEL_CUSTOM_TARBALL=y
BR2_LINUX_KERNEL_CUSTOM_TARBALL_LOCATION="$(call github,raspberrypi,linux,967d45b29ca2902f031b867809d72e3b3d623e7a)/linux-967d45b29ca2902f031b867809d72e3b3d623e7a.tar.gz"
BR2_LINUX_KERNEL_USE_CUSTOM_CONFIG=y
BR2_LINUX_KERNEL_CUSTOM_CONFIG_FILE="board/raspberrypi0w_password_manager/linux.config"
BR2_LINUX_KERNEL_DTS_SUPPORT=y
BR2_LINUX_KERNEL_INTREE_DTS_NAME="bcm2708-rpi-zero-w"
BR2_LINUX_KERNEL_NEEDS_HOST_OPENSSL=y
# on board bluetooth firmware
BR2_PACKAGE_RPI_BT_FIRMWARE=y
# on board wifi firmware
BR2_PACKAGE_RPI_WIFI_FIRMWARE=y

# BOOTLOADER
BR2_PACKAGE_RPI_FIRMWARE=y


# nls
BR2_PACKAGE_NCURSES_WCHAR=y

# input method
BR2_PACKAGE_UIM=y
BR2_PACKAGE_UIM_FEP=y

# busybox
BR2_PACKAGE_BUSYBOX_CONFIG_FRAGMENT_FILES="board/raspberrypi0w_password_manager/addtion-busybox.config"
BR2_PACKAGE_BUSYBOX_SHOW_OTHERS=y
BR2_PACKAGE_BUSYBOX_WATCHDOG=y

# filesystem
BR2_PACKAGE_BTRFS_PROGS=y
BR2_PACKAGE_CRYPTSETUP=y

# terminal 
BR2_PACKAGE_SCREEN=y
BR2_PACKAGE_TMUX=y

# crypt
BR2_PACKAGE_GNUPG2=y
BR2_PACKAGE_GNUPG2_GPGV=y
BR2_PACKAGE_PINENTRY=y
BR2_PACKAGE_PINENTRY_NCURSES=y

# bluetooth
BR2_PACKAGE_BLUEZ_TOOLS=y
BR2_PACKAGE_BLUEZ5_UTILS=y
BR2_PACKAGE_BLUEZ5_UTILS_CLIENT=y
BR2_PACKAGE_BLUEZ5_UTILS_PLUGINS_MESH=y
BR2_PACKAGE_BLUEZ5_UTILS_PLUGINS_SAP=y

# ssh
BR2_PACKAGE_DROPBEAR=y

# firewall
BR2_PACKAGE_NFTABLES=y

# vpn
BR2_PACKAGE_WIREGUARD_TOOLS=y

# wifi
BR2_PACKAGE_WIRELESS_REGDB=y
BR2_PACKAGE_WIRELESS_TOOLS=y
BR2_PACKAGE_WPA_SUPPLICANT=y
BR2_PACKAGE_WPA_SUPPLICANT_NL80211=y
BR2_PACKAGE_WPA_SUPPLICANT_WPA3=y
BR2_PACKAGE_WPA_SUPPLICANT_CLI=y
BR2_PACKAGE_WPA_SUPPLICANT_PASSPHRASE=y
BR2_PACKAGE_WPA_SUPPLICANT_DBUS=y

# ntp
BR2_PACKAGE_CHRONY=y

# Random number generator
BR2_PACKAGE_HAVEGED=y

# password manager
BR2_PACKAGE_PASSWORD_STORE=y

# password-store depends
BR2_PACKAGE_BASH=y
BR2_PACKAGE_TREE=y
BR2_PACKAGE_GIT=y
BR2_PACKAGE_COREUTILS=y

# usb gadget hid input
BR2_PACKAGE_GHID_INPUT=y

# Required tools to create the SD image
BR2_PACKAGE_HOST_DOSFSTOOLS=y
BR2_PACKAGE_HOST_GENIMAGE=y
BR2_PACKAGE_HOST_MTOOLS=y

# Filesystem / image
BR2_TARGET_ROOTFS_BTRFS=y
BR2_TARGET_ROOTFS_BTRFS_SIZE="256M"
BR2_ROOTFS_POST_IMAGE_SCRIPT="board/raspberrypi0w_password_manager/post-image.sh"

# User's custom configuration
BR2_ROOTFS_OVERLAY="board/raspberrypi0w_password_manager/overlay/"
```

## package/ghid-input/Config.in
```kconfig
config BR2_PACKAGE_GHID_INPUT
	bool "ghid-input"
	help
	  A tool used for usb gadget hid

	  https://github.com/luhuins/ghid-input
```

## package/kmscon/Config.in
```kconfig
config BR2_PACKAGE_KMSCON
	bool "kmscon"
	depends on BR2_PACKAGE_HAS_UDEV
	depends on BR2_TOOLCHAIN_HAS_SSP
	select BR2_PACKAGE_LIBDRM
	select BR2_PACKAGE_LIBTSM
	select BR2_PACKAGE_XKEYBOARD_CONFIG # keyboard layout support
	help
	  Kmscon is a simple terminal emulator based on linux kernel
	  mode setting (KMS). It is an attempt to replace the in-kernel
	  VT implementation with a userspace console.

	  https://www.freedesktop.org/wiki/Software/kmscon/
```

## package/password-store/Config.in
```kconfig
config BR2_PACKAGE_PASSWORD_STORE
	bool "password-store"
	select BR2_PACKAGE_BASH
	select BR2_PACKAGE_TREE
	select BR2_PACKAGE_GIT
	select BR2_PACKAGE_COREUTILS
	help
	  Password-store is a password manager which uses
	  GnuPG to store and retrieve passwords. The tool
	  stores each password in its own GnuPG-encrypted
	  file, allowing the program to be simple yet
	  secure.  Synchronization is possible using the
	  integrated git support, which commits changes
	  to your password database to a git repository
	  that can be managed through the pass command.

	  https://www.passwordstore.org/
```

## package/uim/Config.in
```kconfig
config BR2_PACKAGE_UIM
	bool "uim"
	depends on BR2_USE_WCHAR
	depends on BR2_ENABLE_LOCALE # runtime
	select BR2_PACKAGE_HOST_UIM
	help
	  uim is a multilingual input method library and environment.
	  Its goal is to provide simple, easily extensible and high
	  code-quality input method development platform, and useful
	  input method environment for users of desktop and embedded
	  platforms.

	  https://github.com/uim/uim

if BR2_PACKAGE_UIM

config BR2_PACKAGE_UIM_FEP
	bool "uim-fep"
	select BR2_PACKAGE_NCURSES
	select BR2_PACKAGE_NCURSES_WCHAR
	help
	  enable uim console support

endif
```

## package/uim/Config.in.host
```kconfig
config BR2_PACKAGE_HOST_UIM
	bool "host uim"
	help
	  uim is a multilingual input method library and environment.
	  Its goal is to provide simple, easily extensible and high
	  code-quality input method development platform, and useful
	  input method environment for users of desktop and embedded
	  platforms.

	  https://github.com/uim/uim
```
